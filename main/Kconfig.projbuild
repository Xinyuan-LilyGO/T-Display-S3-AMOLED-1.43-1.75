## main/Kconfig.projbuild
```kconfig
menu "Example Configuration"
    config LV_DPI_DEF
        string "Default Dots Per Inch (in px/inch)"
        default "300"

    config LV_DEF_REFR_PERIOD
        string "Default refresh period (ms)"
        default "30"

    config LV_MEM_SIZE_KILOBYTES
        string "Size of the memory used by `lv_malloc()` in kilobytes (>= 2kB)"
        default "300"

    config LV_FS_STDIO_LETTER
        string "Set an upper cased letter on which the drive will accessible (e.g. 65 for 'A')"
        default "65"

    # # 外部解码图片缓冲空间设置大小为：宽度 × 高度 × 4
    # config LV_CACHE_DEF_SIZE
    #     string "Default image cache size. 0 to disable caching"
    #     default "2522880"

    # config LV_USE_MEM_MONITOR
    #     bool "LV_USE_MEM_MONITOR"
    #     default y

    # config LV_MEM_MONITOR_ALIGN_BOTTOM_LEFT
    #     bool "LV_MEM_MONITOR_ALIGN_BOTTOM_LEFT"
    #     default y

    choice
        prompt "Select the example to build"
        default EXAMPLE_BUILD_IIC_SCAN
            config EXAMPLE_BUILD_IIC_SCAN
                bool "iic_scan"
    endchoice

endmenu
```
